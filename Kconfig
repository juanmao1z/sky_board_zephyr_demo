## Kconfig
```kconfig
mainmenu "Sky Board Zephyr Demo"

source "Kconfig.zephyr"

menu "Sky Board Demo Options"

config SKY_BOARD_WS2812_TIM5_DMA_BACKEND
	bool "Enable WS2812 TIM5 CH4 DMA backend"
	default y
	depends on SOC_FAMILY_STM32
	select USE_STM32_HAL_TIM
	select USE_STM32_HAL_TIM_EX
	select USE_STM32_HAL_DMA
	select USE_STM32_HAL_GPIO
	help
	  Enable STM32 HAL TIM/DMA/GPIO modules required by the project
	  WS2812 backend running on TIM5 channel 4 (PA3).

endmenu
```

## boards/st/lckfb_sky_board_stm32f407/Kconfig.board
```kconfig
# Copyright (c) 2016 Linaro Limited.
# SPDX-License-Identifier: Apache-2.0

config BOARD_LCKFB_SKY_BOARD_STM32F407
	select SOC_STM32F407XG
```

## boards/st/lckfb_sky_board_stm32f407/board.yml
```yaml
board:
  name: lckfb_sky_board_stm32f407
  full_name: lckfb_sky_board_stm32f407
  vendor: st
  socs:
    - name: stm32f407xx
```

## dts/bindings/led/lckfb,ws2812-tim5-dma.yaml
```yaml
# SPDX-License-Identifier: Apache-2.0

description: LCKFB WS2812 controller driven by STM32 TIM5 CH4 + DMA.

compatible: "lckfb,ws2812-tim5-dma"

include: base.yaml

properties:
  chain-length:
    type: int
    required: true
    description: Number of LEDs in the strip.

  color-order:
    type: string
    default: "grb"
    description: "Color byte order. Supported values are grb, rgb, brg."

  reset-us:
    type: int
    default: 80
    description: Reset/latch low period in microseconds.

  pixel-offset:
    type: int
    default: 0
    description: >
      Logical-to-physical pixel rotation offset. Effective index is
      (logical_index + pixel-offset) mod chain-length.
```

## sample.yaml
```yaml
sample:
  description: Sky board Zephyr C++ layered demo
  name: sky_board_zephyr_demo
common:
  tags: introduction cpp
  integration_platforms:
    - lckfb_sky_board_stm32f407
```
